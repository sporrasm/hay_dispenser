## main/Kconfig.projbuild
```kconfig
# put here your custom config value
menu "Wi-Fi Configuration"
config ESP_WIFI_SSID
    string "WiFi SSID"
    default "myssid"
    help
	SSID (network name) for the example to connect to.

config ESP_WIFI_PASSWORD
    string "WiFi Password"
    default "mypassword"
    help
	WiFi password (WPA or WPA2) for the example to use.
endmenu
menu "Horse feeder settings"
config FEEDER_TESTMODE 
    bool "If true, disengage locks in rapid succession"
    default false
    help
    Toggle testmode on or off 
if FEEDER_TESTMODE
config TESTMODE_INTERVAL
    int "Interval"
    default 15
    help
    Interval at which locks are disengaged (in seconds)
endif
config LCD_ENABLED
    bool "Toggle LCD on/off"
    default true 
    help
    Toggle the LCD on or off

if LCD_ENABLED
config BUTTONS_ENABLED
    bool "Toggle button functionality on/off"
    default true
    help
    Toggle button functionality on/off
endif 
config NUM_LOCKS
    int "Number of locks"
    default 8
    help
    "Number of locks in hay dispenser"
endmenu
menu "I2C configuration"
config I2C_PULLUP_EN
    bool "I2C pullup"
    default false
    help
        This enables the internal pullup resistors for I2C data and clock pins
config SDA_PIN
    int "SDA pin"
    default 19
    help
        Configure the data pin for I2C intercace
config SCL_PIN
    int "SCL pin"
    default 18
    help
        Configure the clock pin for I2C intercace
endmenu
```
